## main/Kconfig.projbuild
```kconfig
menu "CSI Radar Config"
    config CSI_WIFI_SSID
        string "WiFi SSID"
        default "YOUR_SSID"
        help
            WiFi network name to connect to.
    config CSI_WIFI_PASSWORD
        string "WiFi Password"
        default "YOUR_PASSWORD"
        help
            WiFi network password.
    config CSI_WIFI_CHANNEL
        int "WiFi Channel (1-13)"
        range 1 13
        default 11
        help
            WiFi channel for CSI capture (less interference = better results).
endmenu
```
